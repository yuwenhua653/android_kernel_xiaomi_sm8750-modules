## xiaomi/sla/annibale/Kconfig
```kconfig
config XIAOMI_ANNIBALE_SLA
	tristate "Annibale SLA source candidate (development only)"
	depends on EXPERT && INET && NETFILTER && PROC_FS
	depends on ARM64 && ARM64_4K_PAGES
	default n
	help
	  Same-family MiCode SLA source being qualified for Linux 6.6.
	  Lifetime and packet hardening have only host-test/object-build coverage.
	  Kernel runtime and Annibale userspace remain unqualified; do not ship.
	  This Kconfig is deliberately not sourced by production configurations.
```

## xiaomi/touch/annibale/Kconfig
```kconfig
# SPDX-License-Identifier: GPL-2.0-only
config TOUCHSCREEN_XIAOMI_ANNIBALE
	tristate "Experimental Xiaomi Annibale Goodix 9916K touch modules"
	depends on INPUT && INPUT_TOUCHSCREEN && SPI && I2C && OF
	depends on DRM && QCOM_PANEL_EVENT_NOTIFIER
	depends on NET && POWER_SUPPLY && PROC_FS
	depends on GPIOLIB && REGULATOR && PINCTRL
	default n
	help
	  Build xiaomi_touch and goodix_core from Xiaomi's same-family Warsaw
	  source release. The unpublished Annibale p11 source is not included.
	  Board-specific firmware and THP configuration must be supplied by DT.
	  Hardware, trusted-touch and userspace ABI validation are still needed.
```
